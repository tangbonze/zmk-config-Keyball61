## config/boards/shields/keyball61/Kconfig.shield
```kconfig
config SHIELD_KEYBALL61_LEFT
    def_bool $(shields_list_contains,keyball61_left)

config SHIELD_KEYBALL61_RIGHT
    def_bool $(shields_list_contains,keyball61_right)
```

## config/west.yml
```yaml
manifest:
  remotes:
    - name: zmkfirmware
      url-base: https://github.com/zmkfirmware
    - name: tangbonze
      url-base: https://github.com/tangbonze
  projects:
    - name: zmk
      remote: zmkfirmware
      revision: v0.3
      import: app/west.yml
    - name: zmk-pmw3610-driver
      remote: tangbonze
      revision: main
  self:
    path: config
```
